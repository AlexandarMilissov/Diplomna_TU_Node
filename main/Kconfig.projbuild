## main/Kconfig.projbuild
```kconfig
menu "Wifi Project"
    menu "Monitoring"
        config ENABLE_MONITOR_CHECKBOX
            bool "Enable monitoring"
            default t

        config ENABLE_MONITOR
            int
            default 1 if ENABLE_MONITOR_CHECKBOX
            default 0

        if ENABLE_MONITOR_CHECKBOX

            config ENABLE_MEMORY_MONITOR_CHECKBOX
                bool "Enable memory monitoring"
                default t

            config ENABLE_MEMORY_MONITOR
                int
                default 1 if ENABLE_MEMORY_MONITOR_CHECKBOX
                default 0

            config ENABLE_MESSAGE_MONITOR_CHECKBOX
                bool "Enable message monitoring"
                default t

            config ENABLE_MESSAGE_MONITOR
                int
                default 1 if ENABLE_MESSAGE_MONITOR_CHECKBOX
                default 0

            if ENABLE_MESSAGE_MONITOR_CHECKBOX

                config ENABLE_PEER_MONITOR_CHECKBOX
                    bool "Enable peer monitoring"
                    default t

                config ENABLE_PEER_MONITOR
                    int
                    default 1 if ENABLE_PEER_MONITOR_CHECKBOX
                    default 0

                    if ENABLE_PEER_MONITOR_CHECKBOX
                        config ENABLE_DISTANCE_MONITOR_CHECKBOX
                            bool "Enable distance monitoring"
                            default t

                        config ENABLE_DISTANCE_MONITOR
                            int
                            default 1 if ENABLE_DISTANCE_MONITOR_CHECKBOX
                            default 0
                    endif
            endif
        endif
    endmenu

    menu "ESP NOW Driver"
        config ESPNOW_PMK
            string "ESPNOW primary master key"
            default "pmk1234567890123"
            help
                ESPNOW primary master for the example to use. The length of ESPNOW primary master must be 16 bytes.

        config ESPNOW_LMK
            string "ESPNOW local master key"
            default "lmk1234567890123"
            help
                ESPNOW local master for the example to use. The length of ESPNOW local master must be 16 bytes.

        config ESPNOW_ENABLE_POWER_SAVE
            bool "Enable ESPNOW Power Save"
            default "n"
            select ESP_WIFI_STA_DISCONNECTED_PM_ENABLE
            depends on ESPNOW_WIFI_MODE_STATION
            help
                With ESPNOW power save enabled, chip would be able to wakeup and sleep periodically
                Notice ESP_WIFI_STA_DISCONNECTED_PM_ENABLE is essential at Wi-Fi disconnected

        config ESPNOW_WAKE_WINDOW
            int "ESPNOW wake window, unit in millisecond"
            range 0 65535
            default 50
            depends on ESPNOW_ENABLE_POWER_SAVE
            help
                ESPNOW wake window

        config ESPNOW_WAKE_INTERVAL
            int "ESPNOW wake interval, unit in millisecond"
            range 1 65535
            default 100
            depends on ESPNOW_ENABLE_POWER_SAVE
            help
                ESPNOW wake interval

    endmenu

    menu "Wifi Manager"
        config WIFI_CHANNEL
            int "Channel"
            default 1
            range 0 14
            help
                The channel on which sending and receiving ESPNOW data.
    endmenu

    menu "Distance calculation"
        config USE_RSSI_CHECKBOX
            bool "Use RSSI(dBm) instead of meters"
            default f

        config USE_RSSI
            int
            default 1 if USE_RSSI_CHECKBOX
            default 0

        config MINIMUM_CONFIDENCE_INTERVAL
            int
            range 1 100
            prompt "Total of the confidence interval allowed."
            default 1

        config MINIMUM_NUMBER_OF_VALUES
            int
            range 1 65535
            prompt "Minimum number of values to make a calclulation."
            default 200

        config MAXIMUM_NUMBER_OF_VALUES
            int
            range MINIMUM_NUMBER_OF_VALUES 4294967295
            prompt "Maximum number of values to make a calclulation."
            default 2000

        config RESOLUTION
            int
            range 1 1000
            prompt "Resolution"
            default 10
            help
                Define the resolution of the calculations.
                Higher resolution -> more data containers per meter.
                1 units = 1 m;
                10 units = 1 dm;
                100 units = 1 cm;
                1000 units = 1 mm;

        config RSSI_REF_AT_1_M_NOM
            int
            range -2000 1
            prompt "RSSI reference at 1 meter nominator"
            default -500
            help
                "RSSI reference at 1 meter nominator"

        config RSSI_REF_AT_1_M_DOM
            int
            range 1 1000
            prompt "RSSI reference at 1 meter denominator"
            default 10
            help
                "RSSI reference at 1 meter denominator"

        config NUMBER_OF_MESSAGES_PER_SERIES
            int
            range 1 100
            prompt "Prefered number of messages per series"
            default 10
            help
                "Number of messages per series"

        config MINIMUM_NUMBER_OF_MESSAGES_PER_SERIES
            int
            range 1 NUMBER_OF_MESSAGES_PER_SERIES
            prompt "Minimum number of messages per series"
            default 8
            help
                "The minimum mumber of messages that a series needs to have to be considered valid."

        config LIFE_OF_SERIES
            int
            range 1 100
            prompt "Series life time"
            default 5
            help
                "The times update peers needs to be called before closing a series."

        config LIFE_OF_PEERS
            int
            range 1 100
            prompt "Peers life time"
            default 5
            help
                "The times update peers needs to be called without receiving a keep alive message to consider a peer dead."
            menu "Tasks"

                config SERIES_INITIATION_INTERVAL
                    int
                    range 10 10000
                    prompt "Period of the cyclic send begin function"
                    default 50
                    help
                        "The cooldown period between the starts of 2 calculation message cycles"

                config SERIES_CYCLIC_SEND_INTERVAL
                    int
                    range 1 10000
                    prompt "Period of the cyclic send function"
                    default 3
                    help
                        "The cooldown period between the sending of 2 messages of a series"

                config UPDATE_PEERS_INTERVAL
                    int
                    range 10 10000
                    prompt "Period of the update peers function"
                    default 300
                    help
                        "The period at which the peers are updated"

                config SEND_KEEP_ALIVE_INTERVAL
                    int
                    range 10 10000
                    prompt "Period of the send keep alive function"
                    default 250
                    help
                        "The period at which the keep alive messages are sent"

                config HANDLE_RECEIVED_MESSAGES_INTERVAL
                    int
                    range 10 10000
                    prompt "Period of the handle received messages functions"
                    default 50
                    help
                        "The period at which the received messages are handled."
            endmenu

            menu "Mesh"

                choice
                    bool "Mesh Topology"
                    default MESH_TOPO_TREE
                    help
                        Mesh Network Topology.

                    config MESH_TOPO_TREE
                        bool "MESH_TOPO_TREE"
                    config MESH_TOPO_CHAIN
                        bool "MESH_TOPO_CHAIN"
                endchoice

                config MESH_TOPOLOGY
                    int
                    default 0 if MESH_TOPO_TREE
                    default 1 if MESH_TOPO_CHAIN
                    help
                        Mesh Network Topology.

                config MESH_MAX_LAYER
                    int "Mesh Max Layer"
                    range 1 25 if MESH_TOPO_TREE
                    range 1 1000 if MESH_TOPO_CHAIN
                    default 6
                    help
                        Max layer allowed in mesh network.

                config MESH_CHANNEL
                    int "channel"
                    range 0 14
                    default 0
                    help
                        mesh network channel.

                config MESH_ROUTER_SSID
                    string "Router SSID"
                    default "ROUTER_SSID"
                    help
                        Router SSID.

                config MESH_ROUTER_PASSWD
                    string "Router password"
                    default "ROUTER_PASSWD"
                    help
                        Router password.

                choice
                    bool "Mesh AP Authentication Mode"
                    default WIFI_AUTH_WPA2_PSK
                    help
                        Authentication mode.

                    config WIFI_AUTH_OPEN
                        bool "WIFI_AUTH_OPEN"
                    config WIFI_AUTH_WPA_PSK
                        bool "WIFI_AUTH_WPA_PSK"
                    config WIFI_AUTH_WPA2_PSK
                        bool "WIFI_AUTH_WPA2_PSK"
                    config WIFI_AUTH_WPA_WPA2_PSK
                        bool "WIFI_AUTH_WPA_WPA2_PSK"
                endchoice

                config MESH_AP_AUTHMODE
                    int
                    default 0 if WIFI_AUTH_OPEN
                    default 2 if WIFI_AUTH_WPA_PSK
                    default 3 if WIFI_AUTH_WPA2_PSK
                    default 4 if WIFI_AUTH_WPA_WPA2_PSK
                    help
                        Mesh AP authentication mode.

                config MESH_AP_PASSWD
                    string "Mesh AP Password"
                    default "MAP_PASSWD"
                    help
                        Mesh AP password.

                config MESH_AP_CONNECTIONS
                    int "Mesh AP Connections"
                    range 1 10
                    default 6
                    help
                        The number of mesh stations allowed to connect in.

                config MESH_NON_MESH_AP_CONNECTIONS
                    int "Mesh Non Mesh AP Connections"
                    range 0 9
                    default 0
                    help
                        The number of non-mesh stations allowed to connect in.

                config MESH_ROUTE_TABLE_SIZE
                    int "Mesh Routing Table Size"
                    range 1 300
                    default 50
                    help
                        The number of devices over the network(max: 300).
            endmenu

    endmenu
endmenu
```
